## kernel/Kconfig.fresh
```kconfig
config MINT
	def_bool y
	help
	 This is a Mint kernel build. Enabled by default
	 for Mint Kernel trees.

config MINT_PLATFORM_VERSION
	depends on MINT
	int "Android platform version"
	range 9 13
	help
		Android platform version of Mint build
```

## kernel/Kconfig.oxikernel
```kconfig
config OXIKERNEL
	def_bool y
	help
	 This is an OxiKernel build. Enabled by default for OxiKernel trees.

config OXIKERNEL_PLATFORM_VERSION
	depends on OXIKERNEL
	int "Android platform version"
	range 9 17
	help
		Android platform version targeted by this OxiKernel build.
```
